## configs/zynq_picozed_sdr_defconfig
```kconfig
CONFIG_ARM=y
CONFIG_ZYNQ=y
CONFIG_DM=y
CONFIG_TARGET_ZYNQ_PICOZED_SDR=y
CONFIG_DEFAULT_DEVICE_TREE="zynq-picozed-sdr"
# CONFIG_SYS_MALLOC_F is not set
CONFIG_SPL=y
CONFIG_FIT=y
CONFIG_FIT_VERBOSE=y
CONFIG_FIT_SIGNATURE=y
```
